/*
 * Copyright (c) 2024 Kelvin
 * SPDX-License-Identifier: Apache-2.0
 */

/**
 * @file find_my.c
 * @brief Apple Find My (OpenHaystack) Offline Finding advertisement.
 *
 * Implements the non-connectable BLE advertisement format described in the
 * OpenHaystack paper (https://github.com/seemoo-lab/openhaystack) to make
 * this device visible inside Apple's Find My network.
 *
 * Advertisement layout (Apple Offline Finding, type 0x12)
 * -------------------------------------------------------
 *  AD type  : 0xFF  (Manufacturer Specific)
 *  Company  : 0x004C (Apple)
 *  OF type  : 0x12
 *  OF len   : 0x19  (25 bytes follow)
 *  [0]      : status flags (0x00)
 *  [1..22]  : public_key[6..27]  (22 bytes)
 *  [23]     : public_key[0] >> 6 (key hint, upper 2 bits)
 *  [24]     : 0x00 (reserved)
 *
 * BLE address (random static)
 * ---------------------------
 *  addr[5]  = public_key[0] | 0xC0   (MSB — random-static marker)
 *  addr[4]  = public_key[1]
 *  addr[3]  = public_key[2]
 *  addr[2]  = public_key[3]
 *  addr[1]  = public_key[4]
 *  addr[0]  = public_key[5]          (LSB — Zephyr bt_addr_t is LE)
 */

#include <string.h>

#include <zephyr/bluetooth/bluetooth.h>
#include <zephyr/bluetooth/gap.h>
#include <zephyr/logging/log.h>

#include "find_my.h"

LOG_MODULE_REGISTER(find_my, CONFIG_LOG_DEFAULT_LEVEL);

/* -------------------------------------------------------------------------
 * Demo / placeholder public key
 *
 * This 28-byte value is a DEMONSTRATION PLACEHOLDER only.  It is NOT a
 * valid EC P-224 point and therefore won't decrypt correctly on Apple's
 * servers.  Replace it with a real key pair generated by the OpenHaystack
 * desktop app (https://github.com/seemoo-lab/openhaystack) before shipping.
 *
 * The key is intentionally structured so that:
 *   - Byte 0 = 0x02  (compressed-point prefix, looks like a real key)
 *   - Bytes 1-27 are sequentially numbered for easy visual inspection.
 * ------------------------------------------------------------------------- */
#ifdef CONFIG_FIND_MY_DEMO_KEY
static const uint8_t demo_public_key[FIND_MY_PUBLIC_KEY_SIZE] = {
	0x02, 0x01, 0x02, 0x03, 0x04, 0x05, /* first 6 bytes → BLE address */
	0x06, 0x07, 0x08, 0x09, 0x0a, 0x0b,
	0x0c, 0x0d, 0x0e, 0x0f, 0x10, 0x11,
	0x12, 0x13, 0x14, 0x15, 0x16, 0x17,
	0x18, 0x19, 0x1a, 0x1b,
};
#endif /* CONFIG_FIND_MY_DEMO_KEY */

/* -------------------------------------------------------------------------
 * Module-private state
 * ------------------------------------------------------------------------- */

/*
 * Manufacturer specific data layout:
 *   [0..1]  Apple company ID (0x4C, 0x00)
 *   [2]     OF type (0x12)
 *   [3]     OF sub-length (0x19 = 25)
 *   [4]     status byte (0x00)
 *   [5..26] public_key[6..27]
 *   [27]    public_key[0] >> 6  (key hint)
 *   [28]    reserved (0x00)
 */
#define MANUF_DATA_LEN 29

static uint8_t manuf_data[MANUF_DATA_LEN];

static const struct bt_data find_my_ad[] = {
	BT_DATA_BYTES(BT_DATA_FLAGS, BT_LE_AD_NO_BREDR),
	BT_DATA(BT_DATA_MANUFACTURER_DATA, manuf_data, MANUF_DATA_LEN),
};

static struct bt_le_ext_adv *find_my_adv_set;
static int find_my_id = -1;

/* -------------------------------------------------------------------------
 * Internal helpers
 * ------------------------------------------------------------------------- */

static int build_identity_and_payload(const uint8_t public_key[FIND_MY_PUBLIC_KEY_SIZE])
{
	/* Derive the random-static BLE address from the first 6 key bytes.
	 * Zephyr stores bt_addr_t in little-endian order on the wire, so
	 * val[5] holds the most-significant octet (the one with the static
	 * random marker bits).
	 */
	bt_addr_le_t addr = {
		.type = BT_ADDR_LE_RANDOM,
		.a = {
			.val = {
				public_key[5],
				public_key[4],
				public_key[3],
				public_key[2],
				public_key[1],
				public_key[0] | 0xC0, /* random-static marker */
			},
		},
	};

	/* Fill manufacturer-specific payload. */
	manuf_data[0] = 0x4C; /* Apple company ID LSB */
	manuf_data[1] = 0x00; /* Apple company ID MSB */
	manuf_data[2] = 0x12; /* Offline Finding type  */
	manuf_data[3] = 0x19; /* OF sub-length (25)    */
	manuf_data[4] = 0x00; /* status byte           */
	memcpy(&manuf_data[5], &public_key[6], 22); /* key bytes [6..27] */
	manuf_data[27] = public_key[0] >> 6;         /* key hint           */
	manuf_data[28] = 0x00;                       /* reserved           */

	/* Create a dedicated BLE identity so the Find My address does not
	 * conflict with the connectable image-transfer identity (BT_ID_DEFAULT).
	 */
	int id = bt_id_create(&addr, NULL);

	if (id < 0) {
		LOG_ERR("bt_id_create failed: %d", id);
		return id;
	}

	find_my_id = id;
	LOG_INF("Find My BLE identity created (id=%d)", find_my_id);
	return 0;
}

/* -------------------------------------------------------------------------
 * Public API
 * ------------------------------------------------------------------------- */

int find_my_init(const uint8_t public_key[FIND_MY_PUBLIC_KEY_SIZE])
{
#ifdef CONFIG_FIND_MY_DEMO_KEY
	if (public_key == NULL) {
		LOG_WRN("No key supplied — using built-in demo key (NOT for production)");
		public_key = demo_public_key;
	}
#else
	if (public_key == NULL) {
		LOG_ERR("No public key provided and demo key is disabled");
		return -EINVAL;
	}
#endif

	int err = build_identity_and_payload(public_key);

	if (err) {
		return err;
	}

	/* Create a non-connectable extended advertising set on the Find My
	 * identity.  Extended advertising lets this set run alongside the
	 * regular connectable advertising set used for image transfer.
	 */
	struct bt_le_adv_param param = {
		.id          = find_my_id,
		.sid         = 0,
		.secondary_max_skip = 0,
		.options     = BT_LE_ADV_OPT_USE_IDENTITY,
		.interval_min = BT_GAP_ADV_SLOW_INT_MIN, /* ~1.0 s */
		.interval_max = BT_GAP_ADV_SLOW_INT_MAX, /* ~1.5 s */
		.peer        = NULL,
	};

	err = bt_le_ext_adv_create(&param, NULL, &find_my_adv_set);
	if (err) {
		LOG_ERR("bt_le_ext_adv_create failed: %d", err);
		return err;
	}

	err = bt_le_ext_adv_set_data(find_my_adv_set,
				     find_my_ad, ARRAY_SIZE(find_my_ad),
				     NULL, 0);
	if (err) {
		LOG_ERR("bt_le_ext_adv_set_data failed: %d", err);
		return err;
	}

	LOG_INF("Apple Find My (OpenHaystack) initialised");
	return 0;
}

int find_my_start(void)
{
	if (!find_my_adv_set) {
		LOG_ERR("find_my_start: module not initialised");
		return -EINVAL;
	}

	int err = bt_le_ext_adv_start(find_my_adv_set, BT_LE_EXT_ADV_START_DEFAULT);

	if (err) {
		LOG_ERR("bt_le_ext_adv_start failed: %d", err);
		return err;
	}

	LOG_INF("Apple Find My advertising started");
	return 0;
}

int find_my_stop(void)
{
	if (!find_my_adv_set) {
		return 0;
	}

	int err = bt_le_ext_adv_stop(find_my_adv_set);

	if (err) {
		LOG_ERR("bt_le_ext_adv_stop failed: %d", err);
		return err;
	}

	LOG_INF("Apple Find My advertising stopped");
	return 0;
}

int find_my_rotate_key(const uint8_t public_key[FIND_MY_PUBLIC_KEY_SIZE])
{
	if (public_key == NULL) {
		return -EINVAL;
	}

	/* Stop advertising before reconfiguring. */
	int err = find_my_stop();

	if (err && err != -EALREADY) {
		return err;
	}

	/* Delete the old advertising set and identity. */
	if (find_my_adv_set) {
		bt_le_ext_adv_delete(find_my_adv_set);
		find_my_adv_set = NULL;
	}

	/* Reinitialise with the new key. */
	err = find_my_init(public_key);
	if (err) {
		LOG_ERR("find_my_rotate_key: reinit failed: %d", err);
		return err;
	}

	err = find_my_start();
	if (err) {
		LOG_ERR("find_my_rotate_key: restart failed: %d", err);
	}

	return err;
}
